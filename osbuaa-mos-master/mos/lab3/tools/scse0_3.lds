OUTPUT_ARCH(mips)
ENTRY(_start)

SECTIONS
{
  . = 0x80010000;
  
  /*** exercise 3.12 ***/
  
  /*
  Exercise 1.3. Please complete this part.
  To do:
  fill in the correct address of the key section
  such as text data bss.
  tips: maybe you can find the answer in include/ .
	look for the memory map.
  */

   end = . ;
}
